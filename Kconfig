## Kconfig
```kconfig
config SND_SOC_TFA9XXX
	tristate "NXP Semiconductor TFA9894/TFA9914 audio/haptic controller support"
	depends on I2C
	depends on LEDS_CLASS
	help
	  The TFA9914 is a DSP controlled smart amplifier that can generate
	  waveforms and process a wide range of vibration effects. 

	  To compile this driver as a module, choose M here: the
	  module will be called snd_soc_tfa9xxx.
```
